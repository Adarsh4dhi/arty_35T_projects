/*
 * CAUTION: This file is automatically generated by Xilinx.
 * Version: HSI 2017.2
 * Today is: Mon Jul 10 13:35:55 2017
*/


/dts-v1/;
/include/ "pl.dtsi"
/ {
	chosen {
		bootargs = "earlycon";
		stdout-path = "serial0:115200n8";
	};
	aliases {
		ethernet0 = &axi_ethernetlite_0;
		serial0 = &axi_uartlite_0;
	};
	memory {
		device_type = "memory";
		reg = <0x80000000 0x10000000>;
	};
};
